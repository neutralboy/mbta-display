## main/Kconfig.projbuild
```kconfig
menu "Example Configuration"
    config LV_MEM_SIZE_KILOBYTES
        int "Size of the memory used by `lv_mem_alloc` in kilobytes (>= 2kB)"
        default 48
            
    config LV_USE_DEMO_WIDGETS
        bool "Show some widget"
        default y
        
    config LV_DEMO_WIDGETS_SLIDESHOW
        bool "Enable slide show"
        depends on LV_USE_DEMO_WIDGETS
        default y

    config LV_USE_DEMO_KEYPAD_AND_ENCODER
        bool "Demonstrate the usage of encoder and keyboard"
        default y

    config LV_USE_DEMO_BENCHMARK
        bool "Benchmark your system"
        default y

    config LV_USE_DEMO_STRESS
        bool "Stress test for LVGL"
        default y

    config LV_USE_DEMO_MUSIC
        bool "Music player demo"
        default y

    
    config LV_FONT_MONTSERRAT_12
        bool "Enable Montserrat 12"
        default y if !LV_CONF_MINIMAL

    config LV_FONT_MONTSERRAT_14
        bool "Enable Montserrat 14"
        default y if !LV_CONF_MINIMAL

    config LV_FONT_MONTSERRAT_16
        bool "Enable Montserrat 16"
        default y if !LV_CONF_MINIMAL
endmenu
```

## sdkconfig.defaults
```kconfig
CONFIG_SPIRAM=y
CONFIG_SPIRAM_MODE_OCT=y
CONFIG_SPIRAM_SPEED_80M=y

CONFIG_LV_USE_USER_DATA=y
CONFIG_LV_USE_CHART=y
# CONFIG_LV_USE_PERF_MONITOR is not set

# Enable larger fonts for MBTA UI
CONFIG_LV_FONT_MONTSERRAT_24=y
CONFIG_LV_FONT_MONTSERRAT_48=y

CONFIG_ESPTOOLPY_FLASHSIZE_4MB=y
CONFIG_PARTITION_TABLE_CUSTOM=y

# Disable Bluetooth
CONFIG_BT_ENABLED=n
CONFIG_BT_BLUEDROID_ENABLED=n
CONFIG_BT_NIMBLE_ENABLED=n
CONFIG_BT_CONTROLLER_ENABLED=n

# Optimization & Size reduction
CONFIG_COMPILER_OPTIMIZATION_SIZE=y
CONFIG_NEWLIB_NANO_FORMAT=y
CONFIG_LOG_DEFAULT_LEVEL=2
CONFIG_LWIP_IPV6=n

# Disable unused LVGL features
CONFIG_LV_BUILD_EXAMPLES=n
CONFIG_LV_USE_DEMO_WIDGETS=n
CONFIG_LV_USE_DEMO_KEYPAD_AND_ENCODER=n
CONFIG_LV_USE_DEMO_BENCHMARK=n
CONFIG_LV_USE_DEMO_STRESS=n
CONFIG_LV_USE_DEMO_MUSIC=n
```
